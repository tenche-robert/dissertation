SYSTEM.CPU BCM2711
BREAK.CONFIG.METHOD Program ONCHIP
